## tests/fixtures/corpus/input/conf/layer.conf
```bitbake
# bbtidy corpus layer configuration
BBPATH.=":${LAYERDIR}"

# bbtidy-corpus:opaque-start layer-files
BBFILES += " \
    ${LAYERDIR}/recipes-*/*/*.bb \
    ${LAYERDIR}/recipes-*/*/*.bbappend \
"
# bbtidy-corpus:opaque-end layer-files

BBFILE_COLLECTIONS+="bbtidycorpus"
BBFILE_PATTERN_bbtidycorpus="^${LAYERDIR}/"
BBFILE_PRIORITY_bbtidycorpus="6"
LAYERSERIES_COMPAT_bbtidycorpus="${LAYERSERIES_CORENAMES}"
```
